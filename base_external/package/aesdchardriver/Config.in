## base_external/package/aesdchardriver/Config.in
```kconfig
config BR2_PACKAGE_AESDCHARDRIVER
	bool "aesdchardriver"
	help
	  Supports building and installing the aesd char driver components into the root filesystem
```
